#include <behaviors.dtsi>
#include <behaviors/num_word.dtsi> // requires auto-layer module
#include <behaviors/unicode.dtsi> // requires zmk-unicode module
#include <dt-bindings/zmk/keys.h>
#if CONFIG_WIRELESS
    #include <dt-bindings/zmk/bt.h>
    #define _BT_SEL_KEYS_ &bt BT_SEL 0 &bt BT_SEL 1 &bt BT_SEL 2 &bt BT_SEL 3 &bt BT_CLR
#else
    #define _BT_SEL_KEYS_ &trans &trans &trans &trans &trans
#endif

#include <zmk-helpers/helper.h>
#include <zmk-helpers/key-labels/36.h>  // Define key position labels for 36-key layout
#include <zmk-helpers/unicode-chars/greek.dtsi>
#include <zmk-helpers/unicode-chars/german.dtsi>

#define DEF 0
#define NAV 1
#define SYM 2
#define NUM 3
#define FN 4
#define SYS 5
#define UC 6
#define MOUSE 7

#define XXX &none
#define ___ &trans

/* Global settings */


#define QUICK_TAP_MS 175

&sk {  // sticky-key config
    release-after-ms = <900>;  // release after 0.6s
    quick-release;             // no double capitalization when rolling keys
};

&sl {  // sticky-layer config
    ignore-modifiers;          // allow chording sticky mods & layers
};

&lt {  // layer-tap config
    flavor = "balanced";
    tapping-term-ms = <200>;
    quick-tap-ms = <QUICK_TAP_MS>;
};

/* Homerow mods */

#define KEYS_L LT0 LT1 LT2 LT3 LT4 LM0 LM1 LM2 LM3 LM4 LB0 LB1 LB2 LB3 LB4  // left hand
#define KEYS_R RT0 RT1 RT2 RT3 RT4 RM0 RM1 RM2 RM3 RM4 RB0 RB1 RB2 RB3 RB4  // right hand
#define THUMBS LH2 LH1 LH0 RH0 RH1 RH2                                      // thumbs

#define MAKE_HRM(NAME, HOLD, TAP, TRIGGER_POS) \
    ZMK_BEHAVIOR(NAME, hold_tap, \
        flavor = "balanced"; \
        tapping-term-ms = <280>; \
        quick-tap-ms = <QUICK_TAP_MS>; \
        require-prior-idle-ms = <150>; \
        bindings = <HOLD>, <TAP>; \
        hold-trigger-key-positions = <TRIGGER_POS>; \
        hold-trigger-on-release; \
    )
MAKE_HRM(hml, &kp, &kp, KEYS_R THUMBS)  // left-hand HRMs
MAKE_HRM(hmr, &kp, &kp, KEYS_L THUMBS)  // right-hand HRMs

// Define 8-argument ZMK_COMBO for HRM combos (allows instantaneous chording)
#define ZMK_COMBO_8(NAME, TAP, POS, LAYERS, COMBO_MS, IDLE_MS, HOLD, SIDE)     \
  MAKE_HRM(hm_combo_##NAME, &kp, TAP, SIDE THUMBS)                             \
  ZMK_COMBO_6(NAME, &hm_combo_##NAME HOLD 0, POS, LAYERS, COMBO_MS, IDLE_MS)

MAKE_HRM(hml_repeat, &kp, &key_repeat, KEYS_R THUMBS)  // used for HRM-combo
MAKE_HRM(hmr_lpar_lt, &kp, &lpar_lt, KEYS_L THUMBS)    // "    "   "   "
MAKE_HRM(hmr_rpar_gt, &kp, &rpar_gt, KEYS_L THUMBS)    // "    "   "   "

/* Combos, leader key sequences, mouse emulation */

// #include "../leader.dtsi"  // Temporarily disabled - has compatibility issues
// #include "../combos.dtsi"  // Temporarily disabled - references leader
#include "../mouse.dtsi"

/* Nav cluster */

// long-tap action on hold, short-tap action on all interrupts
#define MT_CORE \
    flavor = "tap-preferred"; \
    tapping-term-ms = <220>; \
    quick-tap-ms = <220>; \
    hold-trigger-key-positions = <0>;

&mt { MT_CORE };
ZMK_HOLD_TAP(mt_home, bindings = <&masked_home>, <&kp>; MT_CORE)
ZMK_HOLD_TAP(mt_end, bindings = <&masked_end>, <&kp>; MT_CORE)

#define NAV_LEFT  &mt_home 0   LEFT    // tap: left  | long-tap: beginning of line
#define NAV_RIGHT &mt_end 0    RIGHT   // tap: right | long-tap: end       of line
#define NAV_UP    &mt LC(HOME) UP      // tap: up    | long-tap: beginning of document
#define NAV_DOWN  &mt LC(END)  DOWN    // tap: down  | long-tap: end       of document
#define NAV_BSPC  &mt LC(BSPC) BSPC    // tap: bspc  | long-tap: delete word backward
#define NAV_DEL   &mt LC(DEL)  DEL     // tap: del   | long-tap: delete word forward

// mask CTRL when holding left/right to avoid accidental jumps to beginning/end of document
#define MASK_MODS(NAME, MODS, BINDING) \
    ZMK_BEHAVIOR(NAME, mod_morph, \
        bindings = <BINDING>, <BINDING>; \
        mods = <MODS>; \
    )
MASK_MODS(masked_home, (MOD_LCTL), &kp HOME)
MASK_MODS(masked_end,  (MOD_LCTL), &kp END)

/* Caps-word, num-word and smart-mouse */

// tap: sticky-shift | shift + tap/ double-tap: caps-word | hold: shift
ZMK_MOD_MORPH(smart_shft,
    bindings = <&sk LSHFT>, <&caps_word>;
    mods = <(MOD_LSFT)>;
)
&caps_word {  // mods deactivate caps-word, requires PR #1451
    /delete-property/ ignore-modifiers;
};

// tap: num-word | double-tap: sticky num-layer | hold: num-layer
ZMK_HOLD_TAP(smart_num,
    flavor = "balanced";
    tapping-term-ms = <200>;
    quick-tap-ms = <QUICK_TAP_MS>;
    bindings = <&mo>, <&num_dance>;
)
ZMK_TAP_DANCE(num_dance,
    tapping-term-ms = <200>;
    bindings = <&num_word NUM>, <&sl NUM>;  // reverse this for sticky-num on single tap
)

// smart-mouse, requires PR #1366
ZMK_TRI_STATE(smart_mouse,
    bindings = <&tog MOUSE>, <&none>, <&tog MOUSE>;
    ignored-key-positions = <LT1 LT3 RT0 RT1 RT2 RT3 RT4 RM1 RM2 RM3 RB1 RB2 RB3 RH0 RH1>;
    ignored-layers = <MOUSE>;
)

/* Custom behaviors */

// Alt+Tab swapper, requires PR #1366
ZMK_TRI_STATE(swapper,
    bindings = <&kt LALT>, <&kp TAB>, <&kt LALT>;
    ignored-key-positions = <LT2>;
)

// Sticky layer + sticky shift (workaround for issue #1421)
ZMK_STICKY_KEY(sls,
    release-after-ms = <1000>;
    bindings = <&uc_shift>;
    ignore-modifiers;
)
ZMK_MACRO(uc_shift,
    wait-ms = <0>;
    tap-ms = <1>;
    bindings = <&macro_press &mo UC &kp LSHFT>
             , <&macro_pause_for_release>
             , <&macro_release &mo UC &kp LSHFT>;
)

// reuse basic mod-morph scheme
#define SIMPLE_MORPH(NAME, MOD, BINDING1, BINDING2) \
    ZMK_MOD_MORPH(NAME, \
        mods = <(MOD_L ## MOD|MOD_R ## MOD)>; \
        bindings = <BINDING1>, <BINDING2>; \
    )
// tap: comma | shift + tap: semicolon | ctrl + shift + tap: <
SIMPLE_MORPH(comma_morph, SFT, &kp COMMA, &comma_inner_morph)
SIMPLE_MORPH(comma_inner_morph, CTL, &kp SEMICOLON, &kp LESS_THAN)

// tap: dot | shift + tap: colon | ctrl + shift + tap: >
SIMPLE_MORPH(dot_morph, SFT, &kp DOT, &dot_inner_morph)
SIMPLE_MORPH(dot_inner_morph, CTL, &kp COLON, &kp GREATER_THAN)

// tap: qmark | shift + tap: excl
SIMPLE_MORPH(qexcl, SFT, &kp QMARK, &kp EXCL)

// tap: left/right parenthesis | shft + tap: less-than/greater-than
SIMPLE_MORPH(lpar_lt, SFT, &kp LPAR, &kp LT)
SIMPLE_MORPH(rpar_gt, SFT, &kp RPAR, &kp GT)

// tap: space | shift + tap: dot -> space -> sticky shift | hold: activate layer
ZMK_HOLD_TAP(lt_spc,
    flavor = "balanced";
    tapping-term-ms = <200>;
    quick-tap-ms = <QUICK_TAP_MS>;
    bindings = <&mo>, <&spc_morph>;
)
SIMPLE_MORPH(spc_morph, SFT, &kp SPACE, &dot_spc)
ZMK_MACRO(dot_spc,
    wait-ms = <0>;
    tap-ms = <5>;
    bindings = <&kp DOT &kp SPACE &sk LSHFT>;
)

// tap: backspace | lshft + tap: delete | rshft + tap: shift-delete
ZMK_MOD_MORPH(bs_del,
    bindings = <&kp BSPC>, <&kp DEL>;
    mods = <(MOD_LSFT|MOD_RSFT)>;
    keep-mods = <MOD_RSFT>;
)

// tap: copy | double-tap: cut
ZMK_TAP_DANCE(copy_cut,
    tapping-term-ms = <200>;
    bindings = <&kp LC(INS)>, <&kp LC(X)>;
)

// Windows sleep key
ZMK_MACRO(win_sleep,
    wait-ms = <500>;
    tap-ms = <50>;
    bindings = <&kp LG(X) &kp U &kp S>;
)

// misc aliases
#define CANCEL      &kp K_CANCEL             // cancel caps-word, num-word and smart-mouse
#define DSK_PREV    &hmr RSHFT LG(LC(LEFT))  // previous desktop
#define DSK_NEXT    &hmr LALT LG(LC(RIGHT))  // next     desktop
#define PIN_WIN     &kp LG(LC(LS(Q)))        // pin window across desktops
#define PIN_APP     &kp LG(LC(LS(A)))        // pin application across desktops
#define DSK_MGR     &kp LA(GRAVE)            // desktop manager
#define VOL_DOWN    &hmr LCTRL C_VOL_DN

#include "sh.dtsi"

ZMK_HOLD_TAP(hld_tap,
    flavor = "hold-preferred";
    tapping-term-ms = <200>;
    bindings = <&kp>, <&kp>;
)

/* Keymap */

ZMK_CONDITIONAL_LAYER(sys, FN NUM, SYS)  // FN + NUM --> SYS

ZMK_LAYER(base,
//╭──────╮ ╭─────────────┬─────────────┬─────────────┬─────────────┬─────────────╮ ╭──────╮ ╭─────────────┬─────────────┬─────────────┬─────────────┬─────────────╮ ╭──────╮
    X_LT     &kp Q         &kp W         &kp E         &kp R         &kp T           X_MT     &kp Y         &kp U         &kp I         &kp O         &kp P           X_RT
//├──────┤ ├─────────────┼─────────────┼─────────────┼─────────────┼─────────────┤ ├──────┤ ├─────────────┼─────────────┼─────────────┼─────────────┼─────────────┤ ├──────┤
    X_LM     &hml LCTRL A  &hml LALT S   &hml LGUI D   &hml LSHFT F  &kp G           X_MM     &kp H         &hmr RSHFT J  &hmr RGUI K   &hmr LALT L  &hmr RCTRL APOS  X_RM
//├──────┤ ├─────────────┼─────────────┼─────────────┼─────────────┼─────────────┤ ├──────┤ ├─────────────┼─────────────┼─────────────┼─────────────┼─────────────┤ ├──────┤
    X_LB     &kp Z         &kp X         &kp C         &kp V         &kp B           X_MB     &kp N         &kp M         &kp COMMA     &kp DOT       &kp SLASH       X_RB
//├──────┤ ╰─────────────┼─────────────┴─────────────┼─────────────┼─────────────┤ ├──────┤ ├─────────────┼─────────────┼─────────────┴───────────────────────────╯ ├──────┤
    X_LH                               &hld_tap LSFT ESC &kp SPACE         &sh_llt NAV TAB    X_MH   &sh_rlt SYM RETURN   &sh_bspc_del_num   &hmr MEH(LGUI) F13                  X_RH
//╰──────╯                                           ╰─────────────┴─────────────╯ ╰──────╯ ╰─────────────┴─────────────╯                                           ╰──────╯
)

ZMK_LAYER(nav,
// ╭──────╮ ╭───────────┬──────────┬───────────┬──────────┬────────────────────────╮    ╭───────────────┬───────────────┬───────────────┬──────────────┬───────╮╭──────╮
     X_LT    &kp C_PWR   ___    &kp LG(LS(GRAVE)) &kp LG(GRAVE)   &kp C_VOL_UP          &kp HOME        &kp PG_DN        &kp PG_UP      &kp END      ___       X_RT
// ├──────┤ ├───────────┼──────────┼───────────┼──────────┼────────────────────────┤    ├───────────────┼───────────────┼───────────────┼──────────────┼───────┤├──────┤
     X_LM &kp LCTRL  ___  &hml LGUI LG(LBRC) &hml LSHIFT LG(RBRC) &kp C_VOL_DN             &kp LEFT        &kp DOWN        &kp UP          &kp RIGHT    ___       X_RM
// ├──────┤ ├───────────┼──────────┼───────────┼──────────┼────────────────────────┤    ├───────────────┼───────────────┼───────────────┼──────────────┼───────┤├──────┤
     X_LB     &bt BT_SEL 2      &bt BT_SEL 1    &bt BT_SEL 0          ___       &caps_word                         &kp RG(LEFT)    &kp RA(LEFT)   &kp RA(RIGHT)    &kp RG(RIGHT)  ___     X_RB
// ├──────┤ ╰───────────┴──────────┼───────────┼──────────┼────────────────────────┤    ├───────────────┼───────────────┼───────────────┼──────────────┴───────╯├──────┤
     X_LH                               ___               ___    ___                                ___       ___                   ___                           X_RH
// ╰──────╯                                       ╰──────────────┴──────────┴────────────────╯    ╰─────────────┴────────────┴────────────────╯                 ╰──────╯
)

ZMK_LAYER(sym,
// ╭──────╮ ╭─────────────────┬───────────────┬──────────────────┬──────────┬───────────────╮ ╭──────────────┬───────────────┬─────────────────────┬─────────────── ┬────────╮╭──────╮
     X_LT     &kp LBRC         &kp AMPERSAND   &kp ASTERISK       &kp PIPE    &kp UNDER         &kp PG_UP      &kp LBKT       &kp RBKT               &kp HOME         ___       X_RT
// ├──────┤ ├─────────────────┼───────────────┼──────────────────┼──────────┼───────────────┤ ├──────────────┼───────────────┼─────────────────────┼─────────────── ┼────────┤├──────┤
     X_LM     &hml LCTRL COLON &hml LALT DOLLAR &hml LGUI PERCENT &hml LSHIFT CARET &kp PLUS   &kp PG_DN      &hmr RSHIFT LBRC  &hmr RGUI RBRC       &hmr RALT END    ___       X_RM
// ├──────┤ ├─────────────────┼───────────────┼──────────────────┼──────────┼───────────────┤ ├──────────────┼───────────────┼─────────────────────┼─────────────── ┼────────┤├──────┤
     X_LB     &kp TILDE         &kp EXCLAMATION &kp AT            &kp HASH    &kp PIPE         &kp RG(LBRC)    &kp RG(LBKT)    &kp RG(RBKT)          &kp RG(RBRC)     ___       X_RB
// ├──────┤ ╰─────────────────┼───────────────┼──────────────────┼──────────┴───────────────┤ ├──────────────┴───────────────┼─────────────────────┼─────────────── ┼────────╯├──────┤
     X_LH                               &kp LBRC          &kp RBRC   &kp UNDER     ___                  ___                   ___                                  X_RH
// ╰──────╯                           ╰─────────────────┴─────────┴───────────╯ ╰────────────────────────┴────────────────────────┴────────────────────────╯    ╰──────╯
)


ZMK_LAYER(num,
// ╭──────╮╭───────────────┬─────────────┬──────────────┬──────────────┬──────────────╮    ╭──────────┬─────────────────┬───────────────┬────────────┬───────╮╭──────╮
     X_LT   &kp PLUS       &kp N7        &kp N8         &kp N9         &kp MINUS            ___        &kp LBKT          &kp RBKT         ___         ___       X_RT
// ├──────┤├───────────────┼─────────────┼──────────────┼──────────────┼──────────────┤    ├──────────┼─────────────────┼───────────────┼────────────┼───────┤├──────┤
     X_LM   &hml LCTRL SEMI &hml LALT N4  &hml LGUI N5   &hml LSHFT N6  &kp EQUAL           ___        &hmr RSHIFT LBRC  &hmr RGUI RBRC   ___         ___       X_RM
// ├──────┤├───────────────┼─────────────┼──────────────┼──────────────┼──────────────┤    ├──────────┼─────────────────┼───────────────┼────────────┼───────┤├──────┤
     X_LB   &kp GRAVE       &kp N1        &kp N2         &kp N3         &kp BACKSLASH       ___         &kp LT           &kp GT           ___         ___       X_RB
// ├──────┤╰───────────────┴─────────────┴──────────────┼──────────────┼──────────────┤    ├──────────┼─────────────────┼───────────────┼────────────┴───────╯├──────┤
     X_LH                                                &kp LPAR  &kp RPAR    &kp N0           ___           ___        ___                                   X_RH
// ╰──────╯                                            ╰───────────┴────────────┴───────────╯    ╰────────────┴──────────┴───────╯                            ╰──────╯
)

ZMK_LAYER(fn,
//╭──────╮ ╭─────────────┬─────────────┬─────────────┬─────────────┬─────────────╮ ╭──────╮ ╭─────────────┬─────────────┬─────────────┬─────────────┬─────────────╮ ╭──────╮
    X_LT     &kp F12       &kp F7        &kp F8        &kp F9        ___             X_MT     ___           &kp C_PREV    &kp C_VOL_UP  &kp C_NEXT    &win_sleep      X_RT
//├──────┤ ├─────────────┼─────────────┼─────────────┼─────────────┼─────────────┤ ├──────┤ ├─────────────┼─────────────┼─────────────┼─────────────┼─────────────┤ ├──────┤
    X_LM     &hml LCTRL F11 &hml LALT F4  &hml LGUI F5 &hml LSHIFT F6 ___             X_MM     ___           DSK_PREV      VOL_DOWN      DSK_NEXT      ___             X_RM
//├──────┤ ├─────────────┼─────────────┼─────────────┼─────────────┼─────────────┤ ├──────┤ ├─────────────┼─────────────┼─────────────┼─────────────┼─────────────┤ ├──────┤
    X_LB     &kp F10       &kp F1        &kp F2        &kp F3        ___             X_MB     PIN_APP       PIN_WIN       DSK_MGR       ___           ___             X_RB
//├──────┤ ╰─────────────┼─────────────┴─────────────┼─────────────┼─────────────┤ ├──────┤ ├─────────────┼─────────────┼─────────────┴───────────────────────────╯ ├──────┤
    X_LH                                               ___           ___             X_MH     &kp C_MUTE    &kp C_PP                                                  X_RH
//╰──────╯                                           ╰─────────────┴─────────────╯ ╰──────╯ ╰─────────────┴─────────────╯                                           ╰──────╯
)

ZMK_LAYER(sys,
//╭──────╮ ╭─────────────┬─────────────┬─────────────┬─────────────┬─────────────╮ ╭──────╮ ╭─────────────┬─────────────┬─────────────┬─────────────┬─────────────╮ ╭──────╮
    X_LT                                _BT_SEL_KEYS_                                X_MT     ___           ___           ___           ___           ___             X_RT
//├──────┤ ├─────────────┼─────────────┼─────────────┼─────────────┼─────────────┤ ├──────┤ ├─────────────┼─────────────┼─────────────┼─────────────┼─────────────┤ ├──────┤
    X_LM     ___           ___           ___           ___           &bootloader     X_MM     &bootloader   ___           ___           ___           ___             X_RM
//├──────┤ ├─────────────┼─────────────┼─────────────┼─────────────┼─────────────┤ ├──────┤ ├─────────────┼─────────────┼─────────────┼─────────────┼─────────────┤ ├──────┤
    X_LB     ___           ___           ___           ___           &sys_reset      X_MB     &sys_reset    ___           ___           ___           ___             X_RB
//├──────┤ ╰─────────────┼─────────────┴─────────────┼─────────────┼─────────────┤ ├──────┤ ├─────────────┼─────────────┼─────────────┴───────────────────────────╯ ├──────┤
    X_LH                                 ___           ___           ___             X_MH     ___           ___           ___                                         X_RH
//╰──────╯                                           ╰─────────────┴─────────────╯ ╰──────╯ ╰─────────────┴─────────────╯                                           ╰──────╯
)


/* vim: set ft=c tw=174: */
