// Corne 36-key (Choco) configuration

// Map extra keys to none for 36-key layout
#define X_LT
#define X_LM
#define X_LB
#define X_LH
#define X_MT
#define X_MM
#define X_MB
#define X_MH
#define X_RT
#define X_RM
#define X_RB
#define X_RH

// Define 36-key thumb layout (enables LH2/RH2 in sh_base.keymap)
#define LH2
#define RH2

// Enable bluetooth
#define CONFIG_WIRELESS 1

// Define MEH and HYP modifiers
#define MEH(k) LC(LS(LA(k)))
#define HYP MEH(LG)

// Use custom timing variant
#include "variants/sh_base.keymap"

// Use 36-key layout (5-column transform)
/ {
    chosen {
        zmk,matrix_transform = &five_column_transform;
    };
};
